## rg350_defconfig
```kconfig
BR2_mipsel=y
BR2_mips_32r2=y
# BR2_MIPS_SOFT_FLOAT is not set
BR2_HOST_DIR="/opt/gcw0-toolchain"
BR2_OPTIMIZE_2=y
BR2_TOOLCHAIN_BUILDROOT_VENDOR="gcw0"
BR2_KERNEL_HEADERS_3_12=y
BR2_UCLIBC_CONFIG="board/opendingux/gcw0/uclibc.config"
BR2_TOOLCHAIN_BUILDROOT_LARGEFILE=y
BR2_TOOLCHAIN_BUILDROOT_INET_IPV6=y
BR2_TOOLCHAIN_BUILDROOT_WCHAR=y
BR2_PTHREAD_DEBUG=y
BR2_BINUTILS_EXTRA_CONFIG_OPTIONS="--enable-lto"
BR2_GCC_VERSION_4_9_X=y
BR2_EXTRA_GCC_CONFIG_OPTIONS="--enable-lto"
BR2_TOOLCHAIN_BUILDROOT_CXX=y
BR2_GCC_ENABLE_GRAPHITE=y
BR2_PACKAGE_HOST_GDB=y
BR2_GDB_VERSION_7_7=y
BR2_TARGET_GENERIC_HOSTNAME="opendingux"
BR2_TARGET_GENERIC_ISSUE="Welcome to OpenDingux"
BR2_INIT_NONE=y
BR2_ROOTFS_DEVICE_CREATION_DYNAMIC_EUDEV=y
BR2_ROOTFS_SKELETON_CUSTOM=y
BR2_ROOTFS_SKELETON_CUSTOM_PATH="board/opendingux/gcw0/target_skeleton"
BR2_TARGET_TZ_INFO=y
BR2_ROOTFS_POST_BUILD_SCRIPT="board/opendingux/gcw0/post-build-script.sh"
# BR2_PACKAGE_BUSYBOX is not set
BR2_PACKAGE_FLAC=y
BR2_PACKAGE_OPENAL_SOFT=y
BR2_PACKAGE_ALLEGRO=y
BR2_PACKAGE_BENNUGD=y
BR2_PACKAGE_FBGRAB=y
BR2_PACKAGE_LOVE2D=y
BR2_PACKAGE_SDL_GFX=y
BR2_PACKAGE_SDL_IMAGE_GIF=y
BR2_PACKAGE_SDL_IMAGE_TARGA=y
BR2_PACKAGE_SDL_IMAGE_XPM=y
BR2_PACKAGE_SDL_NET=y
BR2_PACKAGE_SDL_SOUND=y
BR2_PACKAGE_SDL2_IMAGE=y
BR2_PACKAGE_SDL2_IMAGE_GIF=y
BR2_PACKAGE_SDL2_IMAGE_JPEG=y
BR2_PACKAGE_SDL2_IMAGE_PNG=y
BR2_PACKAGE_SDL2_IMAGE_XPM=y
BR2_PACKAGE_SDL2_MIXER=y
BR2_PACKAGE_SDL2_NET=y
BR2_PACKAGE_SDL2_TTF=y
BR2_PACKAGE_TIMIDITY_INSTRUMENTS=y
BR2_PACKAGE_LINUX_FIRMWARE=y
BR2_PACKAGE_LINUX_FIRMWARE_RTL_81XX=y
BR2_PACKAGE_LIBSHAKE=y
BR2_PACKAGE_LIBSHAKE_PLATFORM="gcw0"
BR2_PACKAGE_LUAJIT=y
BR2_PACKAGE_PYTHON=y
BR2_PACKAGE_PYTHON_CURSES=y
BR2_PACKAGE_PYTHON_PYEXPAT=y
BR2_PACKAGE_PYTHON_READLINE=y
# BR2_PACKAGE_PYTHON_UNICODEDATA is not set
BR2_PACKAGE_PYTHON_SQLITE=y
BR2_PACKAGE_PYTHON_ZLIB=y
BR2_PACKAGE_PYTHON_PYGAME=y
BR2_PACKAGE_PYTHON_PYGAME_IMAGE=y
BR2_PACKAGE_PYTHON_PYGAME_FONT=y
BR2_PACKAGE_PYTHON_PYGAME_MIXER=y
BR2_PACKAGE_PYTHON_PYGAME_MIXER_MUSIC=y
# BR2_PACKAGE_ALSA_LIB_ALISP is not set
# BR2_PACKAGE_ALSA_LIB_OLD_SYMBOLS is not set
BR2_PACKAGE_FLUIDSYNTH=y
BR2_PACKAGE_LIBAO=y
BR2_PACKAGE_LIBSNDFILE=y
BR2_PACKAGE_SPEEX=y
BR2_PACKAGE_TAGLIB=y
BR2_PACKAGE_TREMOR=y
BR2_PACKAGE_PHYSFS=y
BR2_PACKAGE_LIBCONFUSE=y
BR2_PACKAGE_LIBLOCKFILE=y
BR2_PACKAGE_LIBOPK=y
BR2_PACKAGE_LIBSYSFS=y
BR2_PACKAGE_ETNA_VIV=y
BR2_PACKAGE_ETNA_VIV_ABIV4=y
BR2_PACKAGE_LIBUNGIF=y
BR2_PACKAGE_MESA3D_ETNA_VIV=y
BR2_PACKAGE_LIBAIO=y
BR2_PACKAGE_TSLIB=y
BR2_PACKAGE_LIBTHEORA=y
BR2_PACKAGE_LIBNL=y
BR2_PACKAGE_LIBPCAP=y
BR2_PACKAGE_LIBUPNP=y
BR2_PACKAGE_BOOST=y
BR2_PACKAGE_BOOST_STATIC=y
BR2_PACKAGE_BOOST_CHRONO=y
BR2_PACKAGE_BOOST_DATE_TIME=y
BR2_PACKAGE_BOOST_EXCEPTION=y
BR2_PACKAGE_BOOST_FILESYSTEM=y
BR2_PACKAGE_BOOST_GRAPH=y
BR2_PACKAGE_BOOST_IOSTREAMS=y
BR2_PACKAGE_BOOST_LOCALE=y
BR2_PACKAGE_BOOST_MATH=y
BR2_PACKAGE_BOOST_PROGRAM_OPTIONS=y
BR2_PACKAGE_BOOST_RANDOM=y
BR2_PACKAGE_BOOST_REGEX=y
BR2_PACKAGE_BOOST_SERIALIZATION=y
BR2_PACKAGE_BOOST_SIGNALS=y
BR2_PACKAGE_BOOST_SYSTEM=y
BR2_PACKAGE_BOOST_THREAD=y
BR2_PACKAGE_BOOST_TIMER=y
BR2_PACKAGE_GLM=y
BR2_PACKAGE_LIBDAEMON=y
BR2_PACKAGE_LIBXDGMIME=y
BR2_PACKAGE_NCURSES_TARGET_PANEL=y
BR2_PACKAGE_NCURSES_TARGET_FORM=y
BR2_PACKAGE_NCURSES_TARGET_MENU=y
BR2_PACKAGE_POPT=y
BR2_PACKAGE_UTIL_LINUX_LIBMOUNT=y
# BR2_TARGET_ROOTFS_TAR is not set
```
